## main/Kconfig.projbuild
```kconfig
menu "LED Configuration"

    config LED_ENABLE
        bool "Enable LED"
        default n

    config RED_LED_GPIO
        int "CONFIG_RED_BLINK"
        range 0 48
        default 4

    config GREEN_LED_GPIO
        int "CONFIG_GREEN_BLINK"
        range 0 48
        default 16

    config BLUE_LED_GPIO
        int "CONFIG_BLUE_BLINK"
        range 0 48
        default 17

    config BLINK_PERIOD
        int "Blink_period"
        range 10 3600000
        default 1000
        help
            Define the blinking period in milliseconds.

endmenu

menu "WiFi Configuration"

    config SERVER_IP
        string "SERVER IPV4 Address"
        default "192.168.1.16"
        help
            SERVER IPV4 Address.
 
    config SERVER_PORT
        int "Server Port"
        range 0 65535
        default 3333
        help
            The remote port.
 
    config CLIENT_PORT
        int "Client Port"
        range 0 65535
        default 4444
        help
            The local port.

    config ESP_WIFI_SSID
        string "WiFi SSID"
        default "myssid"
        help
            SSID (network name) for the example to connect to.

    config ESP_WIFI_PASSWORD
        string "WiFi Password"
        default "mypassword"
        help
            WiFi password (WPA or WPA2) for the example to use.

    choice ESP_WIFI_SAE_MODE
        prompt "WPA3 SAE mode selection"
        default ESP_STATION_EXAMPLE_WPA3_SAE_PWE_BOTH
        help
            Select mode for SAE as Hunt and Peck, H2E or both.
        config ESP_STATION_EXAMPLE_WPA3_SAE_PWE_HUNT_AND_PECK
            bool "HUNT AND PECK"
        config ESP_STATION_EXAMPLE_WPA3_SAE_PWE_HASH_TO_ELEMENT
            bool "H2E"
            depends on ESP_WIFI_ENABLE_SAE_H2E
        config ESP_STATION_EXAMPLE_WPA3_SAE_PWE_BOTH
            bool "BOTH"
            depends on ESP_WIFI_ENABLE_SAE_H2E
    endchoice

    config ESP_WIFI_PW_ID
        string "PASSWORD IDENTIFIER"
        depends on  ESP_STATION_EXAMPLE_WPA3_SAE_PWE_HASH_TO_ELEMENT|| ESP_STATION_EXAMPLE_WPA3_SAE_PWE_BOTH
        default ""
        help
            password identifier for SAE H2E

    config ESP_MAXIMUM_RETRY
        int "Maximum retry"
        default 50
        help
            Set the Maximum retry to avoid station reconnecting to the AP unlimited when the AP is really inexistent.

    choice ESP_WIFI_SCAN_AUTH_MODE_THRESHOLD
        prompt "WiFi Scan auth mode threshold"
        default ESP_WIFI_AUTH_WPA2_PSK
        help
            The weakest authmode to accept in the scan mode.
            This value defaults to ESP_WIFI_AUTH_WPA2_PSK in case password is present and ESP_WIFI_AUTH_OPEN is used.
            Please select ESP_WIFI_AUTH_WEP/ESP_WIFI_AUTH_WPA_PSK in case AP is operating in WEP/WPA mode.

        config ESP_WIFI_AUTH_OPEN
            bool "OPEN"
        config ESP_WIFI_AUTH_WEP
            bool "WEP"
        config ESP_WIFI_AUTH_WPA_PSK
            bool "WPA PSK"
        config ESP_WIFI_AUTH_WPA2_PSK
            bool "WPA2 PSK"
        config ESP_WIFI_AUTH_WPA_WPA2_PSK
            bool "WPA/WPA2 PSK"
        config ESP_WIFI_AUTH_WPA3_PSK
            bool "WPA3 PSK"
        config ESP_WIFI_AUTH_WPA2_WPA3_PSK
            bool "WPA2/WPA3 PSK"
        config ESP_WIFI_AUTH_WAPI_PSK
            bool "WAPI PSK"
    endchoice

endmenu

menu "LCD Display Configuration"

    config LCD_WIDTH
        int "LCD panel width (pixels)"
        default 240
        range 1 4096
        help
            Width of the LCD panel in pixels.

    config LCD_HEIGHT
        int "LCD panel height (pixels)"
        default 320
        range 1 4096
        help
            Height of the LCD panel in pixels.

    config LCD_SCLK_GPIO
        int "LCD SCLK GPIO"
        default 14
        range 0 48
        help
            GPIO number for SPI SCLK (PIN_D5 = GPIO14).

    config LCD_MOSI_GPIO
        int "LCD MOSI GPIO"
        default 13
        range 0 48
        help
            GPIO number for SPI MOSI (PIN_D7 = GPIO13).

    config LCD_MISO_GPIO
        int "LCD MISO GPIO"
        default 12
        range 0 48
        help
            GPIO number for SPI MISO (PIN_D6 = GPIO12).

    config LCD_CS_GPIO
        int "LCD CS GPIO"
        default 15
        range 0 48
        help
            GPIO number for SPI Chip Select (PIN_D8 = GPIO15).

    config LCD_DC_GPIO
        int "LCD DC GPIO"
        default 0
        range 0 48
        help
            GPIO number for Data/Command (PIN_D3 = GPIO0).

    config LCD_RST_GPIO
        int "LCD Reset GPIO"
        default 2
        range 0 48
        help
            GPIO number for Reset (PIN_D4 = GPIO2).

    config LCD_BL_GPIO
        int "LCD Backlight GPIO"
        default 4
        range 0 48
        help
            GPIO number for Backlight control (PIN_D2 = GPIO4).

    config LCD_BL_ON_LEVEL
        int "Backlight ON level"
        default 1
        range 0 1
        help
            Level to turn backlight ON (0 or 1).

    config LCD_SPI_CLOCK_HZ
        int "SPI clock frequency (Hz)"
        default 27000000
        help
            SPI clock frequency for LCD communication.

    config LCD_SPI_HOST
        int "SPI host"
        default 2
        range 1 3
        help
            SPI host number (SPI1_HOST=1, SPI2_HOST=2, SPI3_HOST=3).

    config LCD_DRAW_BUFF_HEIGHT
        int "Draw buffer height"
        default 50
        range 10 320
        help
            Height of the drawing buffer in pixels.
            Higher values use more RAM but can improve performance.

endmenu

menu "Touch Panel Configuration"

    config TOUCH_ENABLE
        bool "Enable touch panel"
        default y
        help
            Enable touch panel support.

    config TOUCH_SCL_GPIO
        int "Touch SCL GPIO"
        default 32
        range 0 48
        depends on TOUCH_ENABLE
        help
            GPIO number for I2C SCL (IIC_SCL = GPIO32).

    config TOUCH_SDA_GPIO
        int "Touch SDA GPIO"
        default 33
        range 0 48
        depends on TOUCH_ENABLE
        help
            GPIO number for I2C SDA (IIC_SDA = GPIO33).

    config TOUCH_RST_GPIO
        int "Touch Reset GPIO"
        default 25
        range 0 48
        depends on TOUCH_ENABLE
        help
            GPIO number for Touch Reset (IIC_RST = GPIO25).

    config TOUCH_IRQ_GPIO
        int "Touch IRQ GPIO"
        default 36
        range 0 48
        depends on TOUCH_ENABLE
        help
            GPIO number for Touch Interrupt.

    config TOUCH_I2C_CLK_HZ
        int "Touch I2C clock frequency (Hz)"
        default 400000
        depends on TOUCH_ENABLE
        help
            I2C clock frequency for touch panel.

endmenu

menu "LVGL Configuration Override"

    config LV_MEM_SIZE_KILOBYTES
        int "LVGL memory size (KB)"
        default 64
        range 8 1024
        help
            Memory allocated for LVGL in kilobytes.

    config LV_USE_PERF_MONITOR
        bool "Enable performance monitor"
        default y
        help
            Enable LVGL performance monitoring.

    config LV_USE_MEMORY_MONITOR
        bool "Enable memory monitor"
        default y
        help
            Enable LVGL memory usage monitoring.

endmenu
```

## sdkconfig.defaults
```kconfig
# sdkconfig.defaults
# Size flash
CONFIG_ESPTOOLPY_FLASHSIZE_4MB=y
#
# Partition Table
# CONFIG_PARTITION_TABLE_SINGLE_APP is not set
# CONFIG_PARTITION_TABLE_SINGLE_APP_LARGE is not set
# CONFIG_PARTITION_TABLE_TWO_OTA is not set
# CONFIG_PARTITION_TABLE_TWO_OTA_LARGE is not set
CONFIG_PARTITION_TABLE_CUSTOM=y
CONFIG_PARTITION_TABLE_CUSTOM_FILENAME="partitions.csv"
CONFIG_PARTITION_TABLE_FILENAME="partitions.csv"
CONFIG_PARTITION_TABLE_OFFSET=0x8000
CONFIG_PARTITION_TABLE_MD5=y
#
# WiFi Configuration
CONFIG_SERVER_IP="192.168.1.16"
CONFIG_SERVER_PORT=3333
CONFIG_CLIENT_PORT=4444
CONFIG_ESP_WIFI_SSID="esp32"
CONFIG_ESP_WIFI_PASSWORD="93074zar"
CONFIG_ESP_STATION_EXAMPLE_WPA3_SAE_PWE_BOTH=y
CONFIG_ESP_WIFI_PW_ID=""
CONFIG_ESP_MAXIMUM_RETRY=50
CONFIG_ESP_WIFI_AUTH_WPA2_PSK=y
#
# LCD Display Configuration
CONFIG_LCD_WIDTH=320
CONFIG_LCD_HEIGHT=480
CONFIG_LCD_SCLK_GPIO=14
CONFIG_LCD_MOSI_GPIO=13
CONFIG_LCD_MISO_GPIO=12
CONFIG_LCD_CS_GPIO=15
CONFIG_LCD_DC_GPIO=2
CONFIG_LCD_RST_GPIO=2
CONFIG_LCD_BL_GPIO=27

CONFIG_LV_CONF_SKIP=n

# LVGL - отключить монитор производительности (требует LV_USE_SYSMON)
CONFIG_LV_USE_PERF_MONITOR=n
CONFIG_LV_USE_MEM_MONITOR=n
CONFIG_LV_USE_SYSMON=n
#
# Оптимизация
CONFIG_COMPILER_OPTIMIZATION_SIZE=y
```
